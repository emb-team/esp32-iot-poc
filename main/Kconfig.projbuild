## main/Kconfig.projbuild
```kconfig
menu "POC Configuration"

config ESP_WIFI_SSID
    string "WiFi SSID"
    default "TestAP"
    help
	SSID (network name) for the example to connect to.

config ESP_WIFI_PASSWORD
    string "WiFi Password"
    default "nopassword"
    help
	WiFi password (WPA or WPA2) for the example to use.
		
config WIFI_MAX_STA_CONN
    int "Maximal STA connections"
    default 4
    help
	Max number of the STA connects to AP.

config WIFI_MAX_APS_PER_SCAN
    int "Maximum number of Access Points"
    default 20
    help
        Maximum number of Access Points to be shown per WiFi scan.

config FIRMWARE_UPDATE_URL
    string "Firmware update URL endpoint"
    default "https://192.168.0.7/download/poc_v2.bin"
    help
        URL of server which hosts the firmware image.

config BROKER_URI
    string "Broker URL"
    default "mqtts://iot.eclipse.org:8883"
    help
        URL of an mqtt broker to connect to.

endmenu
```
